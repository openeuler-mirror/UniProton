## src/core/kernel/sched/Kconfig
```kconfig
config INTERNAL_OS_SCHEDULE_SINGLE_CORE_BY_CCODE
    bool "single core when the scheduling part is implemented by using the C language or not"
    depends on (OS_MAX_CORE_NUM=1)
    default n
    help
      Internal function macro.This macro is used by the single core when the scheduling part is implemented by using the C language.

config INTERNAL_OS_SCHEDULE_RT
    bool "Whether support rt scheduler or not"
	depends on OS_OPTION_SMP
    default y
```

## src/core/kernel/spinlock/Kconfig
```kconfig
config INTERNAL_OS_SPIN_LOCK
    bool "whether enables spinlock feature"
    default y
```

## src/core/kernel/task/Kconfig
```kconfig
menu "Task module Configuration"

config OS_OPTION_TASK
	bool "Whether support task module or not"
	default n

menu "TASK features configuration"
	depends on OS_OPTION_TASK

config OS_OPTION_TASK_DELETE
	bool "Whether support task delete feature or not"
	default n

config OS_OPTION_TASK_SUSPEND
	bool "Whether support suspend task feature or not"
	default n

config OS_OPTION_TASK_INFO
	bool "Whether support get task information or not"
	default n

config OS_OPTION_TASK_AFFINITY_STATIC
	bool "Whether support task affinity static feature or not"
	help
	if OS_OPTION_TASK_AFFINITY_STATIC=y, when os init, can set task affinity
	if os is running, can not set affinity, this feature now is used belong L2 hac.

config OS_OPTION_TASK_YIELD
	bool "Whether support task yield feature or not"
	default n
	help
	if OS_OPTION_TASK_YIELD=y,when taskdelay(0),can sch task to end list

endmenu

config OS_TSK_PRIORITY_HIGHEST
	int "The highest priority"
	default 0

config OS_TSK_PRIORITY_LOWEST
	int "The lowest priority"
	default 31

config OS_TSK_NUM_OF_PRIORITIES
	int "The number of priority"
	default 32

config OS_TSK_CORE_BYTES_IN_PID
	int "The number of bytes used to indicate core ID in PID "
	default 3

config OS_OPTION_POWEROFF
	bool "Whether support poweroff or not"
	default n

endmenu
```

## src/core/kernel/tick/Kconfig
```kconfig
config OS_OPTION_TICK
    bool "Whether support tick feature or not"
    default y

config OS_OPTION_TICKLESS
    bool "whether support tick less feature or not"
    default n
```

## src/core/kernel/timer/Kconfig
```kconfig
menu "Timer Modules Configuration"

config INTERNAL_OS_SWTMR
	bool "Whether support software timer or not"
	default n

endmenu
```

## src/extended/Kconfig
```kconfig
menu "Extended Low-power Configuration"

config OS_OPTION_LOWPOWER
    bool "Whether support the low-power framework"
    default n

config OS_OPTION_POWERMGR
    bool "Whether support the power manager (light/deep sleep, freq, voting)"
    default n
    depends on OS_OPTION_LOWPOWER

config OS_OPTION_RUNSTOP
    bool "Whether support runstop (suspend-to-storage wake-up)"
    default n
    depends on OS_OPTION_LOWPOWER

config OS_OPTION_RUNSTOP_WOW_SHM
    bool "Whether runstop persists the image via shared memory"
    default n
    depends on OS_OPTION_RUNSTOP

config OS_OPTION_DEEPSLEEP
    bool "Whether support deep sleep (register save/restore on reset)"
    default n
    depends on OS_OPTION_LOWPOWER

endmenu
```

## src/fs/Kconfig
```kconfig
menu "Fs Modules Configuration"

config OS_SUPPORT_FS
	bool "Whether support fs module or not"
	default n

menu "Fs features configuration"
	depends on OS_SUPPORT_FS

config OS_SUPPORT_LITTLEFS
	int "Whether support littlefs module or not"
	default 1

config OS_LFS_MAX_OPEN_FILES
	int "Maximum number of file operations supported by the system"
	default 32

config OS_LFS_MAX_MOUNT_SIZE
	int
	default 3

endmenu
endmenu
```

## src/mem/Kconfig
```kconfig
# Memory allocator algorithm selection
# 通过 Kconfig 宏在 FSC、TLSF、bestfit_little、bestfit 之间切换。
# 以算法名命名，便于后续新增 allocator。
menu "MM Modules Configuration"

config OS_MEM_ARITH_TLSF
    bool "Use TLSF memory allocator"
    default n
    help
      Select y to use the TLSF (Two-Level Segregated Fit) memory allocator
      instead of the default UniProton FSC allocator. The TLSF algorithm
      source is kept in the allocator directory; a thin adaptation shim +
      glue layer is added under src/mem/tlsf/. When enabled, the FSC
      implementation (src/mem/fsc/prt_fscmem.c) is excluded from the build
      and litelibc's malloc_usable_size.c is replaced by the TLSF glue
      implementation.

config OS_MEM_ARITH_BESTFIT_LITTLE
    bool "Use bestfit_little memory allocator"
    default n
    depends on !OS_MEM_ARITH_TLSF && !OS_MEM_ARITH_BESTFIT
    help
      Select y to use the bestfit_little dynamic memory allocator. The
      allocator is integrated as an algorithm peer of FSC/TLSF through the
      existing UniProton memory dispatch table.

config OS_MEM_ARITH_BESTFIT
    bool "Use bestfit memory allocator"
    default n
    depends on !OS_MEM_ARITH_TLSF && !OS_MEM_ARITH_BESTFIT_LITTLE
    help
      Select y to use the full bestfit dynamic memory allocator. The
      allocator is integrated as an algorithm peer of FSC/TLSF through the
      existing UniProton memory dispatch table.

config OS_MEM_SLAB_EXTENTION
    bool "Enable slab extension for bestfit allocators"
    default n
    depends on OS_MEM_ARITH_BESTFIT_LITTLE || OS_MEM_ARITH_BESTFIT
    help
      Enable the slab small-block cache in front of bestfit_little or bestfit.
      Slab is an extension of the selected bestfit heap path, not an independent
      UniProton memory algorithm.

config OS_MEM_SLAB_AUTO_EXPANSION_MODE
    bool "Enable slab auto expansion mode"
    default n
    depends on OS_MEM_SLAB_EXTENTION
    help
      Allow the slab extension to allocate additional buckets from the backing
      bestfit heap.

endmenu
```

## src/net/Kconfig
```kconfig
menu "Net Modules Configuration"

config OS_SUPPORT_NET
	bool "Whether support net module or not"
	default n

menu "Net features configuration"
	depends on OS_SUPPORT_NET

config LWIP_DHCP
	int "Eable LWIP DHCP"
	default 0

config LWIP_IPV6
	int "Enable LWIP IPV6"
	default 1

endmenu
endmenu
```

## src/om/Kconfig
```kconfig
menu "OM Modules Configuration"

source "om/cpup/Kconfig"
source "om/err/Kconfig"
source "om/hook/Kconfig"
source "om/unwind/Kconfig"
source "om/trace/Kconfig"

endmenu
#must ended with empty line
```

## src/om/cpup/Kconfig
```kconfig
config OS_OPTION_CPUP
	bool "Whether support cpup or not"
	default n

menu "CPUP features configuration"
	depends on OS_OPTION_CPUP

choice
	prompt "Cpup Mode"
config INTERNAL_OS_CPUP_THREAD
	bool "CPUP_MODE_THREAD"
endchoice

config OS_OPTION_CPUP_WARN
	bool "Whether support cpup warn or not"
	default n
endmenu
```

## src/om/trace/Kconfig
```kconfig
config OS_OPTION_TRACE
    bool "Whether support trace or not"
    default n

menu "Trace features configuration"
    depends on OS_OPTION_TRACE

    config OS_OPTION_TRACE_FRAME_CORE_MSG
        bool "Record cpuid, hwi status, task lock status"
        default n

    config OS_OPTION_TRACE_FRAME_EVENT_COUNT
        bool "Record event count/sequence"
        default n

    config OS_TRACE_BUFFER_SIZE
        int "Trace buffer size"
        default 2048
        depends on OS_OPTION_TRACE

    config OS_TRACE_OBJ_MAX_NUM
        int "Max number of traced objects"
        default 0
        depends on OS_OPTION_TRACE

    config OS_TRACE_FRAME_MAX_PARAMS
        int "Max params per trace frame"
        default 3
        depends on OS_OPTION_TRACE

endmenu
```

## src/om/unwind/Kconfig
```kconfig
config OS_OPTION_STACKTRACE
    bool "Whether The stacktreace function is supported."
    default n
```

## src/security/Kconfig
```kconfig
menu "security Modules Configuration"

config OS_OPTION_RND
	bool "Whether support user set rnd or not"
	default n

config OS_SUPPORT_MBEDTLS
	bool "Whether support mbedtls module or not"
	default n
      
endmenu
```

## src/utility/Kconfig
```kconfig
menu "Utility Modules Configuration"

config OS_SUPPORT_ZLIB
	bool "Whether support zlib module or not"
	default n

config OS_SUPPORT_OTA
	bool "Whether support OTA module or not"
	default n

config OS_SUPPORT_LWM2M
	bool "Whether support LwM2M module or not"
	default n

config OS_SUPPORT_MQTT
	bool "Whether support MQTT module or not"
	default n

config OS_SUPPORT_NB_IOT
	bool "Whether support NB-IoT module or not"
	default n

endmenu
```
