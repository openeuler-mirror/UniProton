## src/Kconfig
```kconfig
mainmenu "UniProton Configuration"

#should source arch Kconfig first
source "arch/Kconfig"
source "core/Kconfig"
source "mem/Kconfig"
source "om/Kconfig"
source "security/Kconfig"
source "fs/Kconfig"
source "net/Kconfig"
source "utility/Kconfig"
source "shell/Kconfig"
```

## src/arch/Kconfig
```kconfig
menu "Arch Modules Configuration"

source "arch/cpu/Kconfig"

menu "Generic Configuration"
config OS_HARDWARE_PLATFORM
	string
	default "OS_CORTEX_M4" if INTERNAL_OS_PLATFORM_M4

config OS_CPU_TYPE
	string
	default "OS_STM32F407" if INTERNAL_OS_CORTEX_M4

config OS_MAX_CORE_NUM
	int "The maxinum number of cores"
	default 4  if INTERNAL_OS_PLATFORM_ARMV8_AX
	default 1  if INTERNAL_OS_PLATFORM_M4

config INTERNAL_OS_BYTE_ORDER_LE
	bool
	default y
	help
	  This indicates little endian if y

config OS_BYTE_ORDER
	string
	default "OS_LITTLE_ENDIAN" if INTERNAL_OS_BYTE_ORDER_LE
	default "OS_BIG_ENDIAN" if !INTERNAL_OS_BYTE_ORDER_LE

config OS_OPTION_CPU64
	bool "Whether support hardware 64 bit or not"
	default n

config OS_OPTION_SMP
	bool "Whether support mutilple smp os"
	default n

config OS_THIS_CORE
	bool "CoreID used when SMP is disabled"
	depends on !(OS_OPTION_SMP)
    default 3
	
endmenu

endmenu
```

## src/arch/cpu/Kconfig
```kconfig
choice
	prompt "Platform Setup"
config OS_ARCH_ARMV7_M
	bool "ARMV7_M"
config OS_ARCH_X86_64
	bool "X86_64"
config OS_ARCH_RISCV64G
	bool "RISCV64G"
endchoice

source "arch/cpu/riscv64G/Kconfig"
source "arch/cpu/armv7-m/Kconfig"
source "arch/cpu/x86_64/Kconfig"
```

## src/arch/cpu/armv7-m/Kconfig
```kconfig
menu "ARM7-M Sepecfic Configuration"

depends on OS_ARCH_ARMV7_M

config INTERNAL_OS_CORTEX_M4
	bool
	select INTERNAL_OS_BYTE_ORDER_LE

choice
	prompt "Cpu Type"

config INTERNAL_OS_PLATFORM_M4
	bool "CORTEX_M4"
	select INTERNAL_OS_CORTEX_M4

endchoice

source arch/cpu/armv7-m/cortex-m4/Kconfig

endmenu
```

## src/arch/cpu/armv8/Kconfig
```kconfig
menu "ARMV8 Sepecfic Configuration"

depends on (OS_ARCH_ARMV8)

config INTERNAL_OS_PLATFORM_ARMV8_AX
    bool
    select INTERNAL_OS_BYTE_ORDER_LE
    select OS_OPTION_SMP if (OS_MAX_CORE_NUM != 1)

choice
    prompt "Cpu Type"

config INTERNAL_OS_RASPI4
    bool "OS_RASPI4"
    select INTERNAL_OS_PLATFORM_ARMV8_AX

endchoice
```

## src/arch/cpu/riscv64/Kconfig
```kconfig
menu "riscv64 Sepecfic Configuration"

depends on (OS_ARCH_RISCV64)

config INTERNAL_OS_PLATFORM_RISCV64
    bool
    select INTERNAL_OS_BYTE_ORDER_LE
    select OS_OPTION_SMP if (OS_MAX_CORE_NUM != 1)

choice
    prompt "Cpu Type"

config INTERNAL_OS_RISCV64
    bool "OS_RISCV64"
    select INTERNAL_OS_PLATFORM_RISCV64

endchoice

endmenu
```

## src/arch/cpu/riscv64G/Kconfig
```kconfig
menu "riscv64G Sepecfic Configuration"

depends on (OS_ARCH_riscv64G)

config INTERNAL_OS_PLATFORM_RISCV64G
    bool
    select INTERNAL_OS_BYTE_ORDER_LE
    select OS_OPTION_SMP if (OS_MAX_CORE_NUM != 1)

choice
    prompt "Cpu Type"

config INTERNAL_OS_RISCV64G
    bool "OS_RISCV64G"
    select INTERNAL_OS_PLATFORM_RISCV64G

endchoice

endmenu
```

## src/arch/cpu/x86_64/Kconfig
```kconfig
menu "x86_64 Sepecfic Configuration"

depends on (OS_ARCH_X86_64)

config INTERNAL_OS_PLATFORM_X86_64
    bool
    select INTERNAL_OS_BYTE_ORDER_LE
    select OS_OPTION_SMP if (OS_MAX_CORE_NUM != 1)

choice
    prompt "Cpu Type"

config INTERNAL_OS_X86_64
    bool "OS_X86_64"
    select INTERNAL_OS_PLATFORM_X86_64

endchoice

endmenu
```

## src/arch/drv/Kconfig
```kconfig
menu "ARMV8 DRV Features Configuration"
depends on (OS_ARCH_ARMV8)
source "arch/drv/gic/Kconfig"
endmenu
```

## src/arch/drv/gic/Kconfig
```kconfig
config INTERNAL_OS_GIC_VER
    string
    depends on OS_ARCH_ARMV8
    default "gicv600" if (INTERNAL_OS_RASPI4)
```

## src/core/Kconfig
```kconfig
menu "Core Modules Configuration"

source "core/ipc/Kconfig"
source "core/kernel/Kconfig"

endmenu
```

## src/core/ipc/Kconfig
```kconfig
menu "IPC Modules Configuration"
source "core/ipc/event/Kconfig"
source "core/ipc/queue/Kconfig"
source "core/ipc/sem/Kconfig"

endmenu
```

## src/core/ipc/event/Kconfig
```kconfig
menu "Event feature configuration"

config OS_OPTION_EVENT
	bool "Whether support event module or not"
	default n

endmenu
```

## src/core/ipc/queue/Kconfig
```kconfig
config OS_OPTION_QUEUE
	bool "Whether support normal queue module or not"
	default n
```

## src/core/kernel/Kconfig
```kconfig
menu "Kernel Modules Configuration"
source "core/kernel/irq/Kconfig"
source "core/kernel/kexc/Kconfig"
source "core/kernel/sys/Kconfig"
source "core/kernel/task/Kconfig"
source "core/kernel/tick/Kconfig"
source "core/kernel/timer/Kconfig"
endmenu
```

## src/core/kernel/irq/Kconfig
```kconfig
menu "IRQ Modules Configuration"

config OS_OPTION_HWI_COMBINE
	bool "Whether support hw interrupt combination feature or not"
	default y if OS_OPTION_HWI_ATTRIBUTE
	default n if !OS_OPTION_HWI_ATTRIBUTE

config OS_OPTION_HWI_AFFINITY
	bool "Whether support hwi affinity or not"
	default n
	
config OS_OPTION_HWI_PRIORITY
	bool "Whether support hwi priority set or not"
	default y
	
config OS_OPTION_HWI_ATTRIBUTE
	bool "Whether support hwi attribute and Param set or not"
	default y
	
config OS_OPTION_HWI_MAX_NUM_CONFIG
	bool "Whether support interrupt max number config or not"
	default n
    help
      If the number of interrupts needs to be configured, select Y. Otherwise, select N.
      Select Y for the current M4 platform and N for other platforms.

endmenu
```
